## Documentation/devicetree/bindings/media/rockchip-isp1.txt
```
Rockchip SoC Image Signal Processing unit v1
----------------------------------------------

Rockchip ISP1 is the Camera interface for the Rockchip series of SoCs
which contains image processing, scaling, and compression funcitons.

Currently device tree nodes for the Rockchip ISP1 driver includes:
MIPI D-PHY, ISP.

Required properties:
  - compatible: value should be one of the following
      "rockchip,rk3288-cif-isp";
      "rockchip,rk3399-cif-isp";
  - reg : offset and length of the register set for the device.
  - interrupts: should contain ISP interrupt.
  - clocks: phandle to the required clocks.
  - clock-names: required clock name.
  - iommus: required a iommu node.

The device node should contain one 'port' child node with child 'endpoint'
nodes, according to the bindings defined in Documentation/devicetree/bindings/
media/video-interfaces.txt.

Example:
SoC-specific DT entry:
	isp0: isp0@ff910000 {
		compatible = "rockchip,rk3399-cif-isp";
		reg = <0x0 0xff910000 0x0 0x4000>;
		interrupts = <GIC_SPI 43 IRQ_TYPE_LEVEL_HIGH 0>;
		clocks = <&cru SCLK_ISP0>,
			 <&cru ACLK_ISP0>, <&cru ACLK_ISP0_WRAPPER>,
			 <&cru HCLK_ISP0>, <&cru HCLK_ISP0_WRAPPER>;
		clock-names = "clk_isp",
			      "aclk_isp", "aclk_isp_wrap",
			      "hclk_isp", "hclk_isp_wrap";
		power-domains = <&power RK3399_PD_ISP0>;
		iommus = <&isp0_mmu>;
		status = "disabled";
	};

Board-specific:
	isp0: isp0@ff910000 {
		port {
			#address-cells = <1>;
			#size-cells = <0>;

			/* mipi */
			isp0_mipi_in: endpoint@0 {
				reg = <0>;
				remote-endpoint = <&dphy_rx0_out>;
			};

			/* parallel */
			isp0_parallel_in: endpoint@1 {
				reg = <1>;
				remote-endpoint = <&ov5640_out>;
			};
		};
	};

The MIPI-DPHY device binding is defined in rockchip-mipi-dphy.txt.
```

## Documentation/devicetree/bindings/media/rockchip-mipi-dphy.txt
```
Rockchip SoC MIPI RX D-PHY
-------------------------------------------------------------

Required properties:

- compatible: value should be one of the following
    "rockchip,rk3288-mipi-dphy";
    "rockchip,rk3399-mipi-dphy";
- rockchip,grf: GRF regs.
- bus-width	  : maximum number of data lanes supported (SoC specific);
- clocks	  : list of clock specifiers, corresponding to entries in
		    clock-names property;
- clock-names: required clock name.

The device node should contain two 'port' child node, according to the bindings
defined in Documentation/devicetree/bindings/media/video-interfaces.txt.
The first port should be connected to sensor nodes, and the second port should be
connected to isp node. The following are properties specific to those nodes.

endpoint node
-------------

- data-lanes	  : (required) an array specifying active physical MIPI-CSI2
		    data input lanes and their mapping to logical lanes; the
		    array's content is unused, only its length is meaningful;


Example:

/* SoC properties */

    mipi_dphy_rx0: mipi-dphy-rx0 {
        compatible = "rockchip,rk3399-mipi-dphy";
        clocks = <&cru SCLK_MIPIDPHY_REF>,
            <&cru SCLK_DPHY_RX0_CFG>,
            <&cru PCLK_VIO_GRF>;
        clock-names = "dphy-ref", "dphy-cfg", "grf";
        power-domains = <&power RK3399_PD_VIO>;
        bus-width = <4>;
    };

/* Board properties */

    &mipi_phy_rx0 {
        ports {
            #address-cells = <1>;
            #size-cells = <0>;

            port@0 {
                reg = <0>;
                #address-cells = <1>;
                #size-cells = <0>;

                mipi_in_wcam: endpoint@0 {
                    reg = <0>;
                    remote-endpoint = <&wcam_out>;
                    data-lanes = <1 2>;
                };
                mipi_in_ucam: endpoint@1 {
                    reg = <1>;
                    remote-endpoint = <&ucam_out>;
                    data-lanes = <1>;
                };
            };

            port@1 {
                reg = <1>;
                #address-cells = <1>;
                #size-cells = <0>;

                dphy_rx0_out: endpoint@0 {
                    reg = <0>;
                    remote-endpoint = <&isp0_mipi_in>;
                };
            };
        };
    };
```
